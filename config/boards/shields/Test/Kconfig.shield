## config/boards/shields/Test/Kconfig.shield
```kconfig
config SHIELD_KeyballBLE_R
    def_bool $(shields_list_contains,KeyballBLE_R)

config SHIELD_KeyballBLE_L
    def_bool $(shields_list_contains,KeyballBLE_L)
```
